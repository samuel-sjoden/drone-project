## software/open-loop/main/Kconfig.projbuild
```kconfig
menu "Motor GPIO Configuration"

config U_LEG_GPIO
    int "High-side driver for the U"
    default 2

config V_LEG_GPIO
    int "High-side driver for the V leg"
    default 4

config W_LEG_GPIO
    int "High-side driver for the W leg"
    default 5

endmenu
```
